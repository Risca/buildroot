## board/uevm5432/image.its
```
/dts-v1/;

/ {
    description = "OMAP5 uEvm kernel + dtb";
    #address-cells = <1>;

    images {
        kernel {
            description = "Linux kernel";
            data = /incbin/("./zImage");
            type = "kernel";
            arch = "arm";
            os = "linux";
            compression = "none";
            load = <0x80008000>;
            entry = <0x80008000>;
            hash-1 {
                algo = "crc32";
            };
            hash-2 {
                algo = "sha1";
            };
        };
        fdt-1 {
            description = "Flattened Device Tree blob";
            data = /incbin/("./omap5-uevm.dtb");
            type = "flat_dt";
            arch = "arm";
            compression = "none";
            hash-1 {
                    algo = "crc32";
            };
            hash-2 {
                    algo = "sha1";
            };
        };
    };

    configurations {
        default = "config-1";
        config-1 {
            description = "Boot Linux kernel with FDT blob";
            kernel = "kernel";
            fdt = "fdt-1";
        };
    };
};
```

## configs/bifferboard_bootstrap_defconfig
```kconfig
BR2_x86_i486=y
BR2_DL_DIR="/storage/dev/beagleboard/buildroot-dl"
BR2_CCACHE=y
BR2_CCACHE_DIR="$(HOME)/.buildroot-bifferboard-ccache"
BR2_STATIC_LIBS=y
BR2_KERNEL_HEADERS_VERSION=y
BR2_DEFAULT_KERNEL_VERSION="2.6.37"
BR2_PACKAGE_HOST_LINUX_HEADERS_CUSTOM_REALLY_OLD=y
# BR2_UCLIBC_INSTALL_UTILS is not set
BR2_TARGET_OPTIMIZATION="-march=i486 -mtune=i486"
BR2_TARGET_GENERIC_HOSTNAME="bb_bootstrap"
BR2_INIT_NONE=y
BR2_ROOTFS_DEVICE_CREATION_STATIC=y
BR2_ROOTFS_DEVICE_TABLE="board/bifferos/bifferboard_bootstrap/device_table.txt"
# BR2_TARGET_ENABLE_ROOT_LOGIN is not set
# BR2_TARGET_GENERIC_GETTY is not set
# BR2_TARGET_GENERIC_REMOUNT_ROOTFS_RW is not set
BR2_ROOTFS_OVERLAY="board/bifferos/bifferboard_bootstrap/rootfs_overlay"
BR2_ROOTFS_POST_BUILD_SCRIPT="board/bifferos/bifferboard_bootstrap/post_build.sh"
BR2_ROOTFS_POST_IMAGE_SCRIPT="board/bifferos/bifferboard_bootstrap/post_image.sh"
BR2_LINUX_KERNEL=y
BR2_LINUX_KERNEL_CUSTOM_TARBALL=y
BR2_LINUX_KERNEL_CUSTOM_TARBALL_LOCATION="file:///storage/dev/bifferboard/files/linux-2.6.37.6-openwrt-bifferboard.tar.xz"
BR2_LINUX_KERNEL_PATCH="board/bifferos/bifferboard_bootstrap/patches/linux"
BR2_LINUX_KERNEL_USE_CUSTOM_CONFIG=y
BR2_LINUX_KERNEL_CUSTOM_CONFIG_FILE="board/bifferos/bifferboard_bootstrap/linux.config"
BR2_LINUX_KERNEL_LZMA=y
BR2_PACKAGE_BUSYBOX_CONFIG="board/bifferos/bifferboard_bootstrap/busybox.config"
BR2_PACKAGE_KEXEC=y
BR2_PACKAGE_KEXEC_ZLIB=y
# BR2_PACKAGE_IFUPDOWN_SCRIPTS is not set
BR2_TARGET_ROOTFS_INITRAMFS=y
```

## configs/bifferboard_defconfig
```kconfig
BR2_x86_i486=y
BR2_DL_DIR="/storage/dev/beagleboard/buildroot-dl"
BR2_CCACHE=y
BR2_CCACHE_DIR="/var/cache/ccache/buildroot-bifferboard-ccache"
BR2_OPTIMIZE_2=y
BR2_GLOBAL_PATCH_DIR="board/bifferos/bifferboard/patches"
BR2_PACKAGE_HOST_LINUX_HEADERS_CUSTOM_REALLY_OLD=y
BR2_TOOLCHAIN_BUILDROOT_WCHAR=y
# BR2_UCLIBC_INSTALL_UTILS is not set
BR2_TOOLCHAIN_BUILDROOT_CXX=y
BR2_TOOLCHAIN_BUILDROOT_GCCGO=y
BR2_TARGET_OPTIMIZATION="-march=i486 -mtune=i486"
BR2_TOOLCHAIN_GOLD_LINKER=y
BR2_ROOTFS_DEVICE_CREATION_DYNAMIC_EUDEV=y
# BR2_TARGET_GENERIC_GETTY is not set
BR2_SYSTEM_DHCP="enp0s8"
BR2_ROOTFS_OVERLAY="board/bifferos/bifferboard/rootfs_overlay"
BR2_ROOTFS_POST_IMAGE_SCRIPT="board/bifferos/bifferboard/post-image.sh"
BR2_LINUX_KERNEL=y
BR2_LINUX_KERNEL_CUSTOM_TARBALL=y
BR2_LINUX_KERNEL_CUSTOM_TARBALL_LOCATION="file:///storage/dev/bifferboard/files/linux-2.6.37.6-openwrt-bifferboard.tar.xz"
BR2_LINUX_KERNEL_PATCH="board/bifferos/bifferboard/patches/linux"
BR2_LINUX_KERNEL_USE_CUSTOM_CONFIG=y
BR2_LINUX_KERNEL_CUSTOM_CONFIG_FILE="board/bifferos/bifferboard/linux.config"
BR2_LINUX_KERNEL_INSTALL_TARGET=y
BR2_PACKAGE_BUSYBOX_CONFIG="board/bifferos/bifferboard/busybox.config"
BR2_PACKAGE_GHOSTSCRIPT=y
BR2_PACKAGE_BB_ENV=y
BR2_PACKAGE_CA_CERTIFICATES=y
BR2_PACKAGE_LIBUSB=y
BR2_PACKAGE_CUPS=y
BR2_PACKAGE_CUPS_FILTERS=y
BR2_PACKAGE_IPTABLES=y
BR2_PACKAGE_MENDER=y
BR2_TARGET_ROOTFS_EXT2=y
BR2_TARGET_ROOTFS_EXT2_SIZE="200M"
BR2_PACKAGE_HOST_MENDER_ARTIFACT=y
BR2_PACKAGE_HOST_QEMU=y
BR2_PACKAGE_HOST_QEMU_SYSTEM_MODE=y
BR2_PACKAGE_HOST_QEMU_LINUX_USER_MODE=y
```

## configs/uevm5432_defconfig
```kconfig
BR2_arm=y
BR2_cortex_a15=y
BR2_ARM_FPU_NEON_VFPV4=y
BR2_PACKAGE_GLIBC_KERNEL_COMPAT=y
BR2_PACKAGE_GLIBC_UTILS=y
BR2_PACKAGE_HOST_GDB=y
BR2_GDB_VERSION_10=y
BR2_DL_DIR="/mnt/sdb1/buildroot-dl"
BR2_CPAN_MIRROR="http://cpan.metacpan.org"
BR2_CCACHE=y
BR2_CCACHE_DIR="/mnt/sdb1/buildroot-ccache"
BR2_CCACHE_INITIAL_SETUP="--max-size=5G"
BR2_GLOBAL_PATCH_DIR="/mnt/sdb1/omap5_uevm/patches"
BR2_INIT_SYSTEMD=y
BR2_TARGET_GENERIC_ROOT_PASSWD="toor"
BR2_TARGET_GENERIC_GETTY_PORT="ttyS2"
BR2_SYSTEM_DHCP="eth0"
BR2_SYSTEM_DEFAULT_PATH="/bin:/sbin:/usr/bin:/usr/sbin"
BR2_ROOTFS_OVERLAY="board/uevm5432/rootfs-overlay /mnt/sdb1/omap5_uevm/rootfs-overlay"
BR2_ROOTFS_POST_IMAGE_SCRIPT="support/scripts/genimage.sh"
BR2_ROOTFS_POST_SCRIPT_ARGS="-c board/uevm5432/genimage.cfg"
BR2_LINUX_KERNEL=y
BR2_LINUX_KERNEL_CUSTOM_GIT=y
BR2_LINUX_KERNEL_CUSTOM_REPO_URL="/mnt/sdb1/omap5_uevm/linux"
BR2_LINUX_KERNEL_CUSTOM_REPO_VERSION="9f5fd1da8b7f153f41a4f438f3d66c4b240ac7a0"
BR2_LINUX_KERNEL_USE_CUSTOM_CONFIG=y
BR2_LINUX_KERNEL_CUSTOM_CONFIG_FILE="board/uevm5432/linux.config"
BR2_LINUX_KERNEL_DTS_SUPPORT=y
BR2_LINUX_KERNEL_INTREE_DTS_NAME="omap5-uevm"
BR2_LINUX_KERNEL_INSTALL_TARGET=y
BR2_PACKAGE_LINUX_TOOLS_IIO=y
BR2_PACKAGE_ALSA_UTILS=y
BR2_PACKAGE_ALSA_UTILS_APLAY=y
BR2_PACKAGE_PULSEAUDIO=y
BR2_PACKAGE_PULSEAUDIO_DAEMON=y
BR2_PACKAGE_SQUEEZELITE=y
BR2_PACKAGE_SQUEEZELITE_DSD=y
BR2_PACKAGE_SQUEEZELITE_RESAMPLE=y
BR2_PACKAGE_WAVPACK=y
BR2_PACKAGE_DOSFSTOOLS=y
BR2_PACKAGE_DOSFSTOOLS_FATLABEL=y
BR2_PACKAGE_DOSFSTOOLS_FSCK_FAT=y
BR2_PACKAGE_DOSFSTOOLS_MKFS_FAT=y
BR2_PACKAGE_E2FSPROGS=y
BR2_PACKAGE_NFS_UTILS=y
BR2_PACKAGE_NFS_UTILS_NFSV4=y
# BR2_PACKAGE_NFS_UTILS_RPC_NFSD is not set
BR2_PACKAGE_KBD=y
BR2_PACKAGE_LIBID3TAG=y
BR2_PACKAGE_OPUS=y
BR2_PACKAGE_SPEEX=y
BR2_PACKAGE_LIBSERIALPORT=y
BR2_PACKAGE_LIBUSB=y
BR2_PACKAGE_LIBXML2=y
BR2_PACKAGE_PCRE_32=y
BR2_PACKAGE_PCRE2=y
BR2_PACKAGE_DROPBEAR=y
# BR2_PACKAGE_DROPBEAR_CLIENT is not set
BR2_PACKAGE_ETHTOOL=y
BR2_PACKAGE_GESFTPSERVER=y
BR2_PACKAGE_HTOP=y
BR2_PACKAGE_UTIL_LINUX_BINARIES=y
BR2_PACKAGE_VIM=y
BR2_TARGET_ROOTFS_EXT2=y
BR2_TARGET_ROOTFS_EXT2_4=y
BR2_TARGET_ROOTFS_EXT2_SIZE="1G"
BR2_TARGET_ROOTFS_TAR_GZIP=y
BR2_TARGET_UBOOT=y
BR2_TARGET_UBOOT_BUILD_SYSTEM_KCONFIG=y
BR2_TARGET_UBOOT_CUSTOM_VERSION=y
BR2_TARGET_UBOOT_CUSTOM_VERSION_VALUE="2021.04"
BR2_TARGET_UBOOT_BOARD_DEFCONFIG="omap5_uevm"
BR2_TARGET_UBOOT_FORMAT_IMG=y
BR2_TARGET_UBOOT_SPL=y
BR2_TARGET_UBOOT_SPL_NAME="MLO"
BR2_PACKAGE_HOST_DOSFSTOOLS=y
BR2_PACKAGE_HOST_GENIMAGE=y
BR2_PACKAGE_HOST_MTOOLS=y
BR2_PACKAGE_HOST_UBOOT_TOOLS=y
BR2_PACKAGE_HOST_UBOOT_TOOLS_FIT_SUPPORT=y
```

## package/bb_env/Config.in
```kconfig
config BR2_PACKAGE_BB_ENV
	bool "bb_env"
	select BR2_PACKAGE_GNUTLS
	help
	  Clone of the fw_printenv / fw_setenv tools from Das U-Boot, but made
	  for BifferBoard, which allows access to the BifferBoard config block.

	  https://github.com/Risca/bb_env
```

## package/foo2zjs/Config.in
```kconfig
config BR2_PACKAGE_FOO2ZJS
	bool "foo2zjs"
	depends on BR2_PACKAGE_CUPS
	help
	  foo2zjs converts pbm (B/W) images and 1-bit-per-pixel cmyk images
	  (both produced by ghostscript) to Zenographics ZJ-stream format. There
	  is some information about the ZJS format at http://ddk.zeno.com.
	  
	  With foo2zjs, you can print to some HP and Minolta/QMS ZjStream
	  printers, such as these:

	  	- Konica Minolta magicolor 2430 DL	B/W and color
	  	- Minolta/QMS 2300 DL			B/W and color
	  	- Minolta/QMS 2200 DL			B/W and color
	  	- HP LaserJet P2035			B/W
	  	- HP LaserJet M1319 MFP			B/W
	  	- HP LaserJet Pro P1606dn		B/W
	  	- HP LaserJet Pro P1566			B/W
	  	- HP LaserJet Pro P1102			B/W
	  	- HP LaserJet Pro CP1025nw		B/W and color
	  	- HP LaserJet 1022			B/W
	  	- HP LaserJet 1020			B/W
	  	- HP LaserJet 1018			B/W
	  	- HP LaserJet 1005			B/W
	  	- HP LaserJet 1000			B/W
	  
	  http://foo2zjs.rkkda.com/ (dead)
	  https://github.com/koenkooi/foo2zjs (mirror)

if BR2_PACKAGE_FOO2ZJS

config BR2_PACKAGE_FOO2ZJS_PRINTER_MODELS
	string "printer firmware"
	default "all"
	help
	  What firmware files to install to target, or "all" for everything.

endif
```
